
// Generated by slyft.io
// This code part has been generated on an "as is" basis, without warranties or conditions of any kind.


#include "Arduino.h"

#include "value.h"
#include "mpack/mpack.h"
#include "mpack/mpack-platform.h"

void DEMOAPI__value_clean(struct DEMOAPI__value *self) {

	mpack_memset(self->v,0,sizeof(self->v));
}

void DEMOAPI__value_parse_next(struct DEMOAPI__value *self, mpack_reader_t *reader) {

	char	buf_key[2];
	mpack_expect_utf8_cstr(reader, buf_key, sizeof(buf_key));


	if (mpack_memcmp("v",(const char*)buf_key,1) == 0) {
		mpack_expect_utf8_cstr(reader, self->v, sizeof(self->v));
	}


}

int DEMOAPI__value_parse(struct DEMOAPI__value *self, const uint8_t *input_buf, size_t sz_input_buf) {
		mpack_reader_t reader;
    mpack_error_t error;

    mpack_reader_init_data(&reader,(const char *)input_buf, sz_input_buf);
    self->DEMOAPI__value_parse_mpack(self, &reader);

    error = mpack_reader_destroy(&reader);
    if ( error != mpack_ok) {
        return 1;
    } else {
        return 0;
    }

}

void DEMOAPI__value_parse_mpack(struct DEMOAPI__value *self, mpack_reader_t *reader) {

    int count = mpack_expect_map_range(reader, 1, 1);
    for (int i = 0; i < count; i++) {
        DEMOAPI__value_parse_next(self, reader);
    }

    mpack_done_map(reader);
}

size_t DEMOAPI__value_serialize(const struct DEMOAPI__value *self, uint8_t *output_buf, size_t sz_output_buf) {
		struct mpack_writer_t writer;
    mpack_writer_init(&writer,(char*)output_buf,sz_output_buf);

		self->DEMOAPI__value_serialize_mpack(self, &writer);

    size_t used = mpack_writer_buffer_used(&writer);

    // if all is ok, return length of used bytes. Otherwise 0
    if (mpack_writer_destroy(&writer) == mpack_ok) {
        return used;
    } else {
        return (size_t)0;
    }
}

void DEMOAPI__value_serialize_mpack(const struct DEMOAPI__value *self, mpack_writer_t *writer) {
    mpack_start_map(writer, 1);

	mpack_write_cstr(writer, "v"); mpack_write_cstr(writer, self->v);

    mpack_finish_map(writer);
}

void DEMOAPI__value_init(struct DEMOAPI__value *self) {
    self->DEMOAPI__value_clean = &DEMOAPI__value_clean;
    self->DEMOAPI__value_parse = &DEMOAPI__value_parse;
    self->DEMOAPI__value_parse_mpack = &DEMOAPI__value_parse_mpack;
    self->DEMOAPI__value_serialize = &DEMOAPI__value_serialize;
    self->DEMOAPI__value_serialize_mpack = &DEMOAPI__value_serialize_mpack;
    self->DEMOAPI__value_clean(self);
}

//
